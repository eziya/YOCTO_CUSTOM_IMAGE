## build-rpi/conf/bblayers.conf
```bitbake
# POKY_BBLAYERS_CONF_VERSION is increased each time build/conf/bblayers.conf
# changes incompatibly
POKY_BBLAYERS_CONF_VERSION = "2"

BBPATH = "${TOPDIR}"
BBFILES ?= ""

BBLAYERS ?= " \
  /home/eziya76/Workspace/yocto/poky/meta \
  /home/eziya76/Workspace/yocto/poky/meta-poky \
  /home/eziya76/Workspace/yocto/poky/meta-yocto-bsp \
  /home/eziya76/Workspace/yocto/meta-openembedded/meta-oe \
  /home/eziya76/Workspace/yocto/meta-openembedded/meta-python \
  /home/eziya76/Workspace/yocto/meta-openembedded/meta-multimedia \
  /home/eziya76/Workspace/yocto/meta-openembedded/meta-networking \
  /home/eziya76/Workspace/yocto/meta-raspberrypi \
  /home/eziya76/Workspace/yocto/meta-eziya \
  /home/eziya76/Workspace/yocto/meta-java \
  "
```

## meta-eziya/conf/distro/eziya.conf
```bitbake
# Distro information
DISTRO = "eziya"
DISTRO_NAME = "My Own Distro"
DISTRO_DESCRIPTION = "Custom Linux Distribution with systemd"

# Distro version
DISTRO_VERSION = "1.0"

# Enable systemd init
DISTRO_FEATURES:append = " systemd"
VIRTUAL-RUNTIME_init_manager = "systemd"
DISTRO_FEATURES_BACKFILL_CONSIDERED = "sysvinit"
VIRTUAL-RUNTIME_initscripts = "systemd-compat-units"

# Enable systemd network management
DISTRO_FEATURES:append = " systemd-networkd"

# Compiler optimization
TUNE_FEATURES = "arm armv7ve vfp thumb neon callconvention-hard"
```

## meta-eziya/conf/layer.conf
```bitbake
# We have a conf and classes directory, add to BBPATH
BBPATH .= ":${LAYERDIR}"

# We have recipes-* directories, add to BBFILES
BBFILES += "${LAYERDIR}/recipes-*/*/*.bb \
            ${LAYERDIR}/recipes-*/*/*.bbappend"

BBFILE_COLLECTIONS += "meta-eziya"
BBFILE_PATTERN_meta-eziya = "^${LAYERDIR}/"
BBFILE_PRIORITY_meta-ezya = "6"

LAYERDEPENDS_meta-ezya = "core"
LAYERSERIES_COMPAT_meta-eziya = "kirkstone"
```
